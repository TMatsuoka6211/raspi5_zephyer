## CMakeLists.txt
```
# SPDX-License-Identifier: Apache-2.0

cmake_minimum_required(VERSION 3.20.0)

set(FW_IMAGE_NAME "${CMAKE_CURRENT_SOURCE_DIR}/firmware/brcmfmac43455-sdio.bin" CACHE FILEPATH "Firmware binary")
set(CLM_IMAGE_NAME "${CMAKE_CURRENT_SOURCE_DIR}/firmware/brcmfmac43455-sdio.clm_blob" CACHE FILEPATH "CLM blob")
set(NVRAM_IMAGE_NAME "${CMAKE_CURRENT_SOURCE_DIR}/firmware/brcmfmac43455-sdio.txt" CACHE FILEPATH "NVRAM config")

find_package(Zephyr REQUIRED HINTS $ENV{ZEPHYR_BASE})
project(hello_world)

target_sources(app PRIVATE src/main.c)
```

## prj.conf
```kconfig
# nothing here
CONFIG_SDHC=y
CONFIG_SDHC_BCM2712=y
CONFIG_SDIO_STACK=y
CONFIG_LOG=y
CONFIG_LOG_MODE_IMMEDIATE=y
CONFIG_LOG_BUFFER_SIZE=8192
CONFIG_SDHC_LOG_LEVEL_INF=y
CONFIG_SD_LOG_LEVEL_INF=y
CONFIG_MAX_XLAT_TABLES=24
CONFIG_GPIO=y
CONFIG_HEAP_MEM_POOL_SIZE=131072

# Zephyr Shell configurations
CONFIG_SHELL=y
CONFIG_SHELL_BACKENDS=y
CONFIG_SHELL_BACKEND_SERIAL=y
CONFIG_SHELL_ARGC_MAX=10
CONFIG_SHELL_BACKEND_SERIAL_API_POLLING=y

# AIROC WiFi Stack
CONFIG_WIFI=y
CONFIG_WIFI_AIROC=y
CONFIG_AIROC_WIFI_CUSTOM=y

# Networking Stack
CONFIG_NETWORKING=y
CONFIG_NET_L2_ETHERNET=y
CONFIG_NET_L2_WIFI_MGMT=y
CONFIG_NET_IPV4=y
CONFIG_NET_DHCPV4=y
CONFIG_WIFI_STA_AUTO_DHCPV4=y
CONFIG_NET_SHELL=y
CONFIG_NET_L2_WIFI_SHELL=y
CONFIG_WIFI_LOG_LEVEL_INF=y

# 64-bit ARM Stack Sizes (prevent stack overflow into adjacent stacks)
CONFIG_SHELL_STACK_SIZE=16384
CONFIG_NET_MGMT_EVENT_STACK_SIZE=4096
CONFIG_NET_RX_STACK_SIZE=8192
CONFIG_NET_TX_STACK_SIZE=8192
CONFIG_SYSTEM_WORKQUEUE_STACK_SIZE=8192
CONFIG_AIROC_WIFI_EVENT_TASK_STACK_SIZE=4096
CONFIG_MAIN_STACK_SIZE=4096
CONFIG_ISR_STACK_SIZE=4096
CONFIG_NET_SOCKETS_SERVICE_STACK_SIZE=8192
CONFIG_NET_TCP_WORKQ_STACK_SIZE=8192

# DNS リゾルバの有効化（DHCP で取得した DNS サーバーを自動使用、フォールバックに 8.8.8.8）
CONFIG_DNS_RESOLVER=y
CONFIG_DNS_RESOLVER_MAX_SERVERS=2
CONFIG_DNS_NUM_CONCUR_QUERIES=2
CONFIG_DNS_SERVER_IP_ADDRESSES=y
CONFIG_DNS_SERVER1="8.8.8.8"

# TCP プロトコルスタックの有効化
CONFIG_NET_TCP=y
CONFIG_NET_MAX_CONTEXTS=10
CONFIG_NET_TCP_INIT_RETRANSMISSION_TIMEOUT=1000
CONFIG_NET_SOCKETS_CONNECT_TIMEOUT=15000

# HTTP クライアントおよび URL パーサーの有効化
CONFIG_HTTP_CLIENT=y
CONFIG_NET_SHELL_HTTP_CLIENT_URL_LEN=256

# HTTPS (TLS 1.2 & TLS 1.3) サポート
CONFIG_NET_SOCKETS_SOCKOPT_TLS=y
CONFIG_TLS_CREDENTIALS=y
CONFIG_NET_SOCKETS_TLS_MAX_CONTEXTS=4

# Mbed TLS & PSA Crypto 設定
CONFIG_MBEDTLS=y
CONFIG_MBEDTLS_BUILTIN=y
CONFIG_MBEDTLS_ENABLE_HEAP=y
CONFIG_MBEDTLS_HEAP_SIZE=131072
CONFIG_MBEDTLS_SSL_IN_CONTENT_LEN=16384
CONFIG_MBEDTLS_SSL_OUT_CONTENT_LEN=4096
CONFIG_MBEDTLS_PEM_PARSE_C=y
CONFIG_MBEDTLS_PEM_WRITE_C=y
CONFIG_MBEDTLS_SSL_SERVER_NAME_INDICATION=y
CONFIG_PSA_CRYPTO=y
CONFIG_ENTROPY_GENERATOR=y

# 楕円曲線 (Curves) サポート (secp256r1, secp384r1, secp521r1, X25519)
CONFIG_PSA_WANT_ECC_SECP_R1_256=y
CONFIG_PSA_WANT_ECC_SECP_R1_384=y
CONFIG_PSA_WANT_ECC_SECP_R1_521=y
CONFIG_PSA_WANT_ECC_MONTGOMERY_255=y

# TLS 1.2 & TLS 1.3 プロトコル有効化
CONFIG_MBEDTLS_SSL_PROTO_TLS1_2=y
CONFIG_MBEDTLS_SSL_PROTO_TLS1_3=y
CONFIG_MBEDTLS_SSL_TLS1_3_KEY_EXCHANGE_MODE_EPHEMERAL_ENABLED=y

# TLS 1.3 暗号スイート
CONFIG_MBEDTLS_CIPHERSUITE_TLS1_3_AES_128_GCM_SHA256=y
CONFIG_MBEDTLS_CIPHERSUITE_TLS1_3_AES_256_GCM_SHA384=y

# TLS 1.2 暗号スイート (RSA / ECDSA, AES-GCM, SHA-256 / SHA-384 完全対応)
CONFIG_MBEDTLS_CIPHERSUITE_TLS_ECDHE_RSA_WITH_AES_128_GCM_SHA256=y
CONFIG_MBEDTLS_CIPHERSUITE_TLS_ECDHE_ECDSA_WITH_AES_128_GCM_SHA256=y
CONFIG_MBEDTLS_CIPHERSUITE_TLS_ECDHE_RSA_WITH_AES_256_GCM_SHA384=y
CONFIG_MBEDTLS_CIPHERSUITE_TLS_ECDHE_ECDSA_WITH_AES_256_GCM_SHA384=y

# パケットおよびネットバッファプールの拡張（TCP 通信・HTTP 受信時のバッファ枯渇防止）
CONFIG_NET_PKT_RX_COUNT=32
CONFIG_NET_BUF_RX_COUNT=128
CONFIG_NET_PKT_TX_COUNT=32
CONFIG_NET_BUF_TX_COUNT=128
```

## src/main.c
```c
/*
 * Copyright (c) 2012-2014 Wind River Systems, Inc.
 * Copyright 2026 matsuoka
 *
 * SPDX-License-Identifier: Apache-2.0
 */

#include <stdio.h>
#include <stdlib.h>

#include <zephyr/kernel.h>
#include <zephyr/sys/sys_io.h>
#include <zephyr/sys/device_mmio.h>
#include <zephyr/drivers/sdhc.h>
#include <zephyr/sd/sd.h>
#include <zephyr/sd/sdio.h>
#include <zephyr/drivers/gpio.h>
#include <zephyr/shell/shell.h>

struct sd_card g_sd_card;

void configure_bcm2712_pinctrl(void)
{
	mm_reg_t pinctrl_base;
	uintptr_t phys_addr = 0x107d504100;
	size_t size = 0x20;

	device_map(&pinctrl_base, phys_addr, size, K_MEM_CACHE_NONE);

	printk("Mapped BCM2712 pinctrl at 0x%lx\n", (unsigned long)pinctrl_base);

	/* 1. Configure Function Select (Mux) registers for BCM2712 D0:
	 * Offset 0x08 controls Pin 28, 29, 30, 31:
	 *   Pin 28: bits 19-16 -> 0 (GPIO)
	 *   Pin 29: bits 23-20 -> 0 (GPIO)
	 *   Pin 30: bits 27-24 -> 1 (sd2)
	 *   Pin 31: bits 31-28 -> 1 (sd2)
	 *   Value to write: mask out 16-31 and write (1 << 24) | (1 << 28) = 0x11000000
	 */
	uint32_t val = sys_read32(pinctrl_base + 0x08);
	val &= 0x0000FFFF; /* Clear bits 16-31 */
	val |= 0x11000000; /* Write sd2 to pins 30, 31, GPIO to 28, 29 */
	sys_write32(val, pinctrl_base + 0x08);

	/* Offset 0x0C controls Pin 32, 33, 34, 35:
	 *   Pin 32: bits 3-0 -> 1 (sd2)
	 *   Pin 33: bits 7-4 -> 1 (sd2)
	 *   Pin 34: bits 11-8 -> 1 (sd2)
	 *   Pin 35: bits 15-12 -> 1 (sd2)
	 *   Value to write: mask out 0-15 and write 1 | (1 << 4) | (1 << 8) | (1 << 12) = 0x1111
	 */
	val = sys_read32(pinctrl_base + 0x0C);
	val &= 0xFFFF0000; /* Clear bits 0-15 */
	val |= 0x1111;     /* Write sd2 to pins 32, 33, 34, 35 */
	sys_write32(val, pinctrl_base + 0x0C);

	/* 2. Configure Pull (Bias) registers for BCM2712 D0:
	 * Offset 0x14 controls Pin 28-32 pull-up/pull-down:
	 *   Pin 28: bits 21-20 -> 0 (None)
	 *   Pin 29: bits 23-22 -> 0 (None)
	 *   Pin 30: bits 25-24 -> 0 (None)
	 *   Pin 31: bits 27-26 -> 2 (Pull-Up) -> 2 << 26 = 0x08000000
	 *   Pin 32: bits 29-28 -> 2 (Pull-Up) -> 2 << 28 = 0x20000000
	 *   Value to write: mask out bits 20-31 and write 0x28000000
	 */
	val = sys_read32(pinctrl_base + 0x14);
	val &= ~0xFFF00000; /* Clear bits 20-31 */
	val |= 0x28000000;  /* Set Pin 31, 32 to Pull-Up (2), Pin 30 to None (0) */
	sys_write32(val, pinctrl_base + 0x14);

	/* Offset 0x18 controls Pin 33-35 pull-up/pull-down:
	 *   Pin 33: bits 1-0 -> 2 (Pull-Up) -> 2
	 *   Pin 34: bits 3-2 -> 2 (Pull-Up) -> 2 << 2 = 8
	 *   Pin 35: bits 5-4 -> 2 (Pull-Up) -> 2 << 4 = 0x20
	 *   Value to write: mask out bits 0-5 and write 2 | 8 | 0x20 = 0x2A
	 */
	val = sys_read32(pinctrl_base + 0x18);
	val &= ~0x0000003F; /* Clear bits 0-5 */
	val |= 0x0000002A;  /* Set Pin 33-35 to Pull-Up (2) */
	sys_write32(val, pinctrl_base + 0x18);

	printk("BCM2712 SDIO pinctrl registers written successfully!\n");

	device_unmap(pinctrl_base, size);
}

/* --- Zephyr Shell command handlers --- */

static int cmd_sdio_pinctrl(const struct shell *sh, size_t argc, char **argv)
{
	shell_print(sh, "Configuring BCM2712 SDIO Pin Muxing...");
	configure_bcm2712_pinctrl();
	shell_print(sh, "Pin Muxing configuration completed successfully.");
	return 0;
}

static int cmd_sdio_power(const struct shell *sh, size_t argc, char **argv)
{
	const struct device *const gpio_dev = DEVICE_DT_GET(DT_NODELABEL(gio));

	if (!device_is_ready(gpio_dev)) {
		shell_error(sh, "GPIO device not ready!");
		return -ENODEV;
	}

	if (strcmp(argv[1], "on") == 0) {
		gpio_pin_configure(gpio_dev, 28, GPIO_OUTPUT_ACTIVE);
		shell_print(sh, "WL_ON (GPIO 28) set to HIGH (WiFi Power ON).");
	} else if (strcmp(argv[1], "off") == 0) {
		gpio_pin_configure(gpio_dev, 28, GPIO_OUTPUT_INACTIVE);
		shell_print(sh, "WL_ON (GPIO 28) set to LOW (WiFi Power OFF).");
	} else {
		shell_error(sh, "Usage: sdio power <on|off>");
		return -EINVAL;
	}
	return 0;
}

static int cmd_sdio_init(const struct shell *sh, size_t argc, char **argv)
{
	const struct device *const sdhc_dev = DEVICE_DT_GET(DT_NODELABEL(sdhci1));
	const struct device *const gpio_dev = DEVICE_DT_GET(DT_NODELABEL(gio));

	if (!device_is_ready(sdhc_dev)) {
		shell_error(sh, "SDHC device not ready!");
		return -ENODEV;
	}

	if (device_is_ready(gpio_dev)) {
		shell_print(sh, "Power cycling WiFi chip (WL_ON / GPIO 28)...");
		/* Power OFF */
		gpio_pin_configure(gpio_dev, 28, GPIO_OUTPUT_INACTIVE);
		k_msleep(100);
		/* Re-configure BCM2712 pinctrl */
		configure_bcm2712_pinctrl();
		/* Power ON */
		gpio_pin_configure(gpio_dev, 28, GPIO_OUTPUT_ACTIVE);
		k_msleep(150);
	}

	shell_print(sh, "Initializing SD/SDIO Card...");
	int ret = sd_init(sdhc_dev, &g_sd_card);
	if (ret < 0) {
		shell_error(sh, "sd_init failed: %d", ret);
		return ret;
	}

	shell_print(sh, "sd_init succeeded! Card Status: %d, Card Type: %d (1: SDIO, 0: SDMMC)",
				g_sd_card.status, g_sd_card.type);
	return 0;
}

static int cmd_sdio_read(const struct shell *sh, size_t argc, char **argv)
{
	if (g_sd_card.status != CARD_INITIALIZED) {
		shell_error(sh, "Card is not initialized. Run 'sdio init' first.");
		return -EAGAIN;
	}

	uint8_t func_num = strtoul(argv[1], NULL, 0);
	uint32_t addr = strtoul(argv[2], NULL, 0);
	uint8_t val = 0;

	struct sdio_func func = {
		.num = func_num,
		.card = &g_sd_card
	};

	int ret = sdio_read_byte(&func, addr, &val);
	if (ret < 0) {
		shell_error(sh, "sdio_read_byte failed: %d", ret);
		return ret;
	}

	shell_print(sh, "Read Success: Func %d, Addr 0x%04X = 0x%02X", func_num, addr, val);
	return 0;
}

static int cmd_sdio_write(const struct shell *sh, size_t argc, char **argv)
{
	if (g_sd_card.status != CARD_INITIALIZED) {
		shell_error(sh, "Card is not initialized. Run 'sdio init' first.");
		return -EAGAIN;
	}

	uint8_t func_num = strtoul(argv[1], NULL, 0);
	uint32_t addr = strtoul(argv[2], NULL, 0);
	uint8_t val = strtoul(argv[3], NULL, 0);
	uint8_t resp = 0;

	struct sdio_func func = {
		.num = func_num,
		.card = &g_sd_card
	};

	int ret = sdio_rw_byte(&func, addr, val, &resp);
	if (ret < 0) {
		shell_error(sh, "sdio_rw_byte failed: %d", ret);
		return ret;
	}

	shell_print(sh, "Write Success: Func %d, Addr 0x%04X <- 0x%02X (Response: 0x%02X)",
				func_num, addr, val, resp);
	return 0;
}

extern char g_airoc_boot_log[4096];

static void print_airoc_boot_log(void)
{
	printk("\n=== AIROC BOOT DIAGNOSTIC LOG ===\n");
	const char *p = g_airoc_boot_log;
	char line[160];
	while (*p) {
		size_t i = 0;
		while (*p && *p != '\n' && i < sizeof(line) - 1) {
			line[i++] = *p++;
		}
		if (*p == '\n') {
			p++;
		}
		line[i] = '\0';
		printk("%s\n", line);
		k_msleep(5);
	}
	printk("=================================\n");
}

static int cmd_sdio_log(const struct shell *sh, size_t argc, char **argv)
{
	ARG_UNUSED(sh);
	ARG_UNUSED(argc);
	ARG_UNUSED(argv);
	print_airoc_boot_log();
	return 0;
}

/* Register subcommands and root command 'sdio' */
SHELL_STATIC_SUBCMD_SET_CREATE(sub_sdio,
	SHELL_CMD(log, NULL, "Print AIROC boot diagnostic log", cmd_sdio_log),
	SHELL_CMD(pinctrl, NULL, "Configure BCM2712 SDIO Pin Muxing", cmd_sdio_pinctrl),
	SHELL_CMD_ARG(power, NULL, "Set WL_ON (GPIO 28) <on/off>", cmd_sdio_power, 2, 0),
	SHELL_CMD(init, NULL, "Initialize SDIO WiFi Card", cmd_sdio_init),
	SHELL_CMD_ARG(read, NULL, "Read SDIO register (CMD52) <func_num> <addr>", cmd_sdio_read, 3, 0),
	SHELL_CMD_ARG(write, NULL, "Write SDIO register (CMD52) <func_num> <addr> <val>", cmd_sdio_write, 4, 0),
	SHELL_SUBCMD_SET_END
);

SHELL_CMD_REGISTER(sdio, &sub_sdio, "BCM2712 SDIO Control Commands", NULL);

int main(void)
{
	printf("Starting Zephyr on %s with Infineon AIROC WiFi...\n", CONFIG_BOARD_TARGET);
	configure_bcm2712_pinctrl();
	print_airoc_boot_log();
	return 0;
}
```
