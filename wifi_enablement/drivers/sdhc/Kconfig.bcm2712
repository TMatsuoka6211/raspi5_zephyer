## wifi_enablement/drivers/sdhc/Kconfig.bcm2712
```kconfig
# Copyright 2026 matsuoka
# Copyright 2026 matsuoka
# SPDX-License-Identifier: Apache-2.0

config SDHC_BCM2712
	bool "Broadcom BCM2712 SDHCI controller driver"
	default y
	depends on DT_HAS_BRCM_BCM2712_SDHCI_ENABLED
	select SDHC_SUPPORTS_NATIVE_MODE
	help
	  Enable the Broadcom BCM2712 SDHCI controller driver.
```

## wifi_enablement/dts/bindings/sdhc/brcm,bcm2712-sdhci.yaml
```yaml
# Copyright 2026 matsuoka
# SPDX-License-Identifier: Apache-2.0

description: Broadcom BCM2712 SDHCI/eMMC/SDIO controller

compatible: "brcm,bcm2712-sdhci"

include: [sdhc.yaml, pinctrl-device.yaml]

properties:
  reg:
    required: true
  interrupts:
    required: true
  clocks:
    required: true
```
